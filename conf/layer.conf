## conf/layer.conf
```bitbake
# We have a conf and classes directory, add to BBPATH
BBPATH .= ":${LAYERDIR}"

# We have recipes-* directories, add to BBFILES
BBFILES += "${LAYERDIR}/recipes-*/*/*.bb \
            ${LAYERDIR}/recipes-*/*/*.bbappend"

BBFILE_COLLECTIONS += "meta-adtran-imx8mm"
BBFILE_PATTERN_meta-adtran-imx8mm = "^${LAYERDIR}/"
BBFILE_PRIORITY_meta-adtran-imx8mm = "6"

LAYERDEPENDS_meta-adtran-imx8mm = "core"
LAYERSERIES_COMPAT_meta-adtran-imx8mm = "warrior zeus"
```
